;
; File Name: cyfitterrv.inc
; 
; PSoC Creator  4.4
;
; Description:
; 
;
;-------------------------------------------------------------------------------
; Copyright (c) 2007-2020 Cypress Semiconductor.  All rights reserved.
; You may use this file only in accordance with the license, terms, conditions, 
; disclaimers, and limitations in the end user license agreement accompanying 
; the software package with which this file was provided.
;-------------------------------------------------------------------------------

    IF :LNOT::DEF:INCLUDED_CYFITTERRV_INC
INCLUDED_CYFITTERRV_INC EQU 1
    GET cydevicerv.inc
    GET cydevicerv_trm.inc

; sw_azul
sw_azul__0__INTTYPE EQU CYREG_PICU1_INTTYPE7
sw_azul__0__MASK EQU 0x80
sw_azul__0__PC EQU CYREG_PRT1_PC7
sw_azul__0__PORT EQU 1
sw_azul__0__SHIFT EQU 7
sw_azul__AG EQU CYREG_PRT1_AG
sw_azul__AMUX EQU CYREG_PRT1_AMUX
sw_azul__BIE EQU CYREG_PRT1_BIE
sw_azul__BIT_MASK EQU CYREG_PRT1_BIT_MASK
sw_azul__BYP EQU CYREG_PRT1_BYP
sw_azul__CTL EQU CYREG_PRT1_CTL
sw_azul__DM0 EQU CYREG_PRT1_DM0
sw_azul__DM1 EQU CYREG_PRT1_DM1
sw_azul__DM2 EQU CYREG_PRT1_DM2
sw_azul__DR EQU CYREG_PRT1_DR
sw_azul__INP_DIS EQU CYREG_PRT1_INP_DIS
sw_azul__INTTYPE_BASE EQU CYDEV_PICU_INTTYPE_PICU1_BASE
sw_azul__LCD_COM_SEG EQU CYREG_PRT1_LCD_COM_SEG
sw_azul__LCD_EN EQU CYREG_PRT1_LCD_EN
sw_azul__MASK EQU 0x80
sw_azul__PORT EQU 1
sw_azul__PRT EQU CYREG_PRT1_PRT
sw_azul__PRTDSI__CAPS_SEL EQU CYREG_PRT1_CAPS_SEL
sw_azul__PRTDSI__DBL_SYNC_IN EQU CYREG_PRT1_DBL_SYNC_IN
sw_azul__PRTDSI__OE_SEL0 EQU CYREG_PRT1_OE_SEL0
sw_azul__PRTDSI__OE_SEL1 EQU CYREG_PRT1_OE_SEL1
sw_azul__PRTDSI__OUT_SEL0 EQU CYREG_PRT1_OUT_SEL0
sw_azul__PRTDSI__OUT_SEL1 EQU CYREG_PRT1_OUT_SEL1
sw_azul__PRTDSI__SYNC_OUT EQU CYREG_PRT1_SYNC_OUT
sw_azul__PS EQU CYREG_PRT1_PS
sw_azul__SHIFT EQU 7
sw_azul__SLW EQU CYREG_PRT1_SLW

; sw_rojo
sw_rojo__0__INTTYPE EQU CYREG_PICU2_INTTYPE2
sw_rojo__0__MASK EQU 0x04
sw_rojo__0__PC EQU CYREG_PRT2_PC2
sw_rojo__0__PORT EQU 2
sw_rojo__0__SHIFT EQU 2
sw_rojo__AG EQU CYREG_PRT2_AG
sw_rojo__AMUX EQU CYREG_PRT2_AMUX
sw_rojo__BIE EQU CYREG_PRT2_BIE
sw_rojo__BIT_MASK EQU CYREG_PRT2_BIT_MASK
sw_rojo__BYP EQU CYREG_PRT2_BYP
sw_rojo__CTL EQU CYREG_PRT2_CTL
sw_rojo__DM0 EQU CYREG_PRT2_DM0
sw_rojo__DM1 EQU CYREG_PRT2_DM1
sw_rojo__DM2 EQU CYREG_PRT2_DM2
sw_rojo__DR EQU CYREG_PRT2_DR
sw_rojo__INP_DIS EQU CYREG_PRT2_INP_DIS
sw_rojo__INTTYPE_BASE EQU CYDEV_PICU_INTTYPE_PICU2_BASE
sw_rojo__LCD_COM_SEG EQU CYREG_PRT2_LCD_COM_SEG
sw_rojo__LCD_EN EQU CYREG_PRT2_LCD_EN
sw_rojo__MASK EQU 0x04
sw_rojo__PORT EQU 2
sw_rojo__PRT EQU CYREG_PRT2_PRT
sw_rojo__PRTDSI__CAPS_SEL EQU CYREG_PRT2_CAPS_SEL
sw_rojo__PRTDSI__DBL_SYNC_IN EQU CYREG_PRT2_DBL_SYNC_IN
sw_rojo__PRTDSI__OE_SEL0 EQU CYREG_PRT2_OE_SEL0
sw_rojo__PRTDSI__OE_SEL1 EQU CYREG_PRT2_OE_SEL1
sw_rojo__PRTDSI__OUT_SEL0 EQU CYREG_PRT2_OUT_SEL0
sw_rojo__PRTDSI__OUT_SEL1 EQU CYREG_PRT2_OUT_SEL1
sw_rojo__PRTDSI__SYNC_OUT EQU CYREG_PRT2_SYNC_OUT
sw_rojo__PS EQU CYREG_PRT2_PS
sw_rojo__SHIFT EQU 2
sw_rojo__SLW EQU CYREG_PRT2_SLW

; led_azul
led_azul__0__INTTYPE EQU CYREG_PICU1_INTTYPE5
led_azul__0__MASK EQU 0x20
led_azul__0__PC EQU CYREG_PRT1_PC5
led_azul__0__PORT EQU 1
led_azul__0__SHIFT EQU 5
led_azul__AG EQU CYREG_PRT1_AG
led_azul__AMUX EQU CYREG_PRT1_AMUX
led_azul__BIE EQU CYREG_PRT1_BIE
led_azul__BIT_MASK EQU CYREG_PRT1_BIT_MASK
led_azul__BYP EQU CYREG_PRT1_BYP
led_azul__CTL EQU CYREG_PRT1_CTL
led_azul__DM0 EQU CYREG_PRT1_DM0
led_azul__DM1 EQU CYREG_PRT1_DM1
led_azul__DM2 EQU CYREG_PRT1_DM2
led_azul__DR EQU CYREG_PRT1_DR
led_azul__INP_DIS EQU CYREG_PRT1_INP_DIS
led_azul__INTTYPE_BASE EQU CYDEV_PICU_INTTYPE_PICU1_BASE
led_azul__LCD_COM_SEG EQU CYREG_PRT1_LCD_COM_SEG
led_azul__LCD_EN EQU CYREG_PRT1_LCD_EN
led_azul__MASK EQU 0x20
led_azul__PORT EQU 1
led_azul__PRT EQU CYREG_PRT1_PRT
led_azul__PRTDSI__CAPS_SEL EQU CYREG_PRT1_CAPS_SEL
led_azul__PRTDSI__DBL_SYNC_IN EQU CYREG_PRT1_DBL_SYNC_IN
led_azul__PRTDSI__OE_SEL0 EQU CYREG_PRT1_OE_SEL0
led_azul__PRTDSI__OE_SEL1 EQU CYREG_PRT1_OE_SEL1
led_azul__PRTDSI__OUT_SEL0 EQU CYREG_PRT1_OUT_SEL0
led_azul__PRTDSI__OUT_SEL1 EQU CYREG_PRT1_OUT_SEL1
led_azul__PRTDSI__SYNC_OUT EQU CYREG_PRT1_SYNC_OUT
led_azul__PS EQU CYREG_PRT1_PS
led_azul__SHIFT EQU 5
led_azul__SLW EQU CYREG_PRT1_SLW

; led_rojo
led_rojo__0__INTTYPE EQU CYREG_PICU1_INTTYPE2
led_rojo__0__MASK EQU 0x04
led_rojo__0__PC EQU CYREG_PRT1_PC2
led_rojo__0__PORT EQU 1
led_rojo__0__SHIFT EQU 2
led_rojo__AG EQU CYREG_PRT1_AG
led_rojo__AMUX EQU CYREG_PRT1_AMUX
led_rojo__BIE EQU CYREG_PRT1_BIE
led_rojo__BIT_MASK EQU CYREG_PRT1_BIT_MASK
led_rojo__BYP EQU CYREG_PRT1_BYP
led_rojo__CTL EQU CYREG_PRT1_CTL
led_rojo__DM0 EQU CYREG_PRT1_DM0
led_rojo__DM1 EQU CYREG_PRT1_DM1
led_rojo__DM2 EQU CYREG_PRT1_DM2
led_rojo__DR EQU CYREG_PRT1_DR
led_rojo__INP_DIS EQU CYREG_PRT1_INP_DIS
led_rojo__INTTYPE_BASE EQU CYDEV_PICU_INTTYPE_PICU1_BASE
led_rojo__LCD_COM_SEG EQU CYREG_PRT1_LCD_COM_SEG
led_rojo__LCD_EN EQU CYREG_PRT1_LCD_EN
led_rojo__MASK EQU 0x04
led_rojo__PORT EQU 1
led_rojo__PRT EQU CYREG_PRT1_PRT
led_rojo__PRTDSI__CAPS_SEL EQU CYREG_PRT1_CAPS_SEL
led_rojo__PRTDSI__DBL_SYNC_IN EQU CYREG_PRT1_DBL_SYNC_IN
led_rojo__PRTDSI__OE_SEL0 EQU CYREG_PRT1_OE_SEL0
led_rojo__PRTDSI__OE_SEL1 EQU CYREG_PRT1_OE_SEL1
led_rojo__PRTDSI__OUT_SEL0 EQU CYREG_PRT1_OUT_SEL0
led_rojo__PRTDSI__OUT_SEL1 EQU CYREG_PRT1_OUT_SEL1
led_rojo__PRTDSI__SYNC_OUT EQU CYREG_PRT1_SYNC_OUT
led_rojo__PS EQU CYREG_PRT1_PS
led_rojo__SHIFT EQU 2
led_rojo__SLW EQU CYREG_PRT1_SLW

; Miscellaneous
BCLK__BUS_CLK__HZ EQU 24000000
BCLK__BUS_CLK__KHZ EQU 24000
BCLK__BUS_CLK__MHZ EQU 24
CYDEV_CHIP_DIE_LEOPARD EQU 1
CYDEV_CHIP_DIE_PSOC4A EQU 26
CYDEV_CHIP_DIE_PSOC5LP EQU 2
CYDEV_CHIP_DIE_PSOC5TM EQU 3
CYDEV_CHIP_DIE_TMA4 EQU 4
CYDEV_CHIP_DIE_UNKNOWN EQU 0
CYDEV_CHIP_FAMILY_FM0P EQU 5
CYDEV_CHIP_FAMILY_FM3 EQU 6
CYDEV_CHIP_FAMILY_FM4 EQU 7
CYDEV_CHIP_FAMILY_PSOC3 EQU 1
CYDEV_CHIP_FAMILY_PSOC4 EQU 2
CYDEV_CHIP_FAMILY_PSOC5 EQU 3
CYDEV_CHIP_FAMILY_PSOC6 EQU 4
CYDEV_CHIP_FAMILY_UNKNOWN EQU 0
CYDEV_CHIP_FAMILY_USED EQU CYDEV_CHIP_FAMILY_PSOC5
CYDEV_CHIP_JTAG_ID EQU 0x2E161069
CYDEV_CHIP_MEMBER_3A EQU 1
CYDEV_CHIP_MEMBER_4A EQU 26
CYDEV_CHIP_MEMBER_4AA EQU 25
CYDEV_CHIP_MEMBER_4AB EQU 30
CYDEV_CHIP_MEMBER_4AC EQU 14
CYDEV_CHIP_MEMBER_4AD EQU 15
CYDEV_CHIP_MEMBER_4AE EQU 16
CYDEV_CHIP_MEMBER_4D EQU 20
CYDEV_CHIP_MEMBER_4E EQU 6
CYDEV_CHIP_MEMBER_4F EQU 27
CYDEV_CHIP_MEMBER_4G EQU 4
CYDEV_CHIP_MEMBER_4H EQU 24
CYDEV_CHIP_MEMBER_4I EQU 32
CYDEV_CHIP_MEMBER_4J EQU 21
CYDEV_CHIP_MEMBER_4K EQU 22
CYDEV_CHIP_MEMBER_4L EQU 31
CYDEV_CHIP_MEMBER_4M EQU 29
CYDEV_CHIP_MEMBER_4N EQU 11
CYDEV_CHIP_MEMBER_4O EQU 8
CYDEV_CHIP_MEMBER_4P EQU 28
CYDEV_CHIP_MEMBER_4Q EQU 17
CYDEV_CHIP_MEMBER_4R EQU 9
CYDEV_CHIP_MEMBER_4S EQU 12
CYDEV_CHIP_MEMBER_4T EQU 10
CYDEV_CHIP_MEMBER_4U EQU 5
CYDEV_CHIP_MEMBER_4V EQU 23
CYDEV_CHIP_MEMBER_4W EQU 13
CYDEV_CHIP_MEMBER_4X EQU 7
CYDEV_CHIP_MEMBER_4Y EQU 18
CYDEV_CHIP_MEMBER_4Z EQU 19
CYDEV_CHIP_MEMBER_5A EQU 3
CYDEV_CHIP_MEMBER_5B EQU 2
CYDEV_CHIP_MEMBER_6A EQU 33
CYDEV_CHIP_MEMBER_FM3 EQU 37
CYDEV_CHIP_MEMBER_FM4 EQU 38
CYDEV_CHIP_MEMBER_PDL_FM0P_TYPE1 EQU 34
CYDEV_CHIP_MEMBER_PDL_FM0P_TYPE2 EQU 35
CYDEV_CHIP_MEMBER_PDL_FM0P_TYPE3 EQU 36
CYDEV_CHIP_MEMBER_UNKNOWN EQU 0
CYDEV_CHIP_MEMBER_USED EQU CYDEV_CHIP_MEMBER_5B
CYDEV_CHIP_DIE_EXPECT EQU CYDEV_CHIP_MEMBER_USED
CYDEV_CHIP_DIE_ACTUAL EQU CYDEV_CHIP_DIE_EXPECT
CYDEV_CHIP_REV_LEOPARD_ES1 EQU 0
CYDEV_CHIP_REV_LEOPARD_ES2 EQU 1
CYDEV_CHIP_REV_LEOPARD_ES3 EQU 3
CYDEV_CHIP_REV_LEOPARD_PRODUCTION EQU 3
CYDEV_CHIP_REV_PSOC4A_ES0 EQU 17
CYDEV_CHIP_REV_PSOC4A_PRODUCTION EQU 17
CYDEV_CHIP_REV_PSOC5LP_ES0 EQU 0
CYDEV_CHIP_REV_PSOC5LP_PRODUCTION EQU 0
CYDEV_CHIP_REV_PSOC5TM_ES0 EQU 0
CYDEV_CHIP_REV_PSOC5TM_ES1 EQU 1
CYDEV_CHIP_REV_PSOC5TM_PRODUCTION EQU 1
CYDEV_CHIP_REV_TMA4_ES EQU 17
CYDEV_CHIP_REV_TMA4_ES2 EQU 33
CYDEV_CHIP_REV_TMA4_PRODUCTION EQU 17
CYDEV_CHIP_REVISION_3A_ES1 EQU 0
CYDEV_CHIP_REVISION_3A_ES2 EQU 1
CYDEV_CHIP_REVISION_3A_ES3 EQU 3
CYDEV_CHIP_REVISION_3A_PRODUCTION EQU 3
CYDEV_CHIP_REVISION_4A_ES0 EQU 17
CYDEV_CHIP_REVISION_4A_PRODUCTION EQU 17
CYDEV_CHIP_REVISION_4AA_PRODUCTION EQU 0
CYDEV_CHIP_REVISION_4AB_PRODUCTION EQU 0
CYDEV_CHIP_REVISION_4AC_PRODUCTION EQU 0
CYDEV_CHIP_REVISION_4AD_PRODUCTION EQU 0
CYDEV_CHIP_REVISION_4AE_PRODUCTION EQU 0
CYDEV_CHIP_REVISION_4D_PRODUCTION EQU 0
CYDEV_CHIP_REVISION_4E_CCG2_NO_USBPD EQU 0
CYDEV_CHIP_REVISION_4E_PRODUCTION EQU 0
CYDEV_CHIP_REVISION_4F_PRODUCTION EQU 0
CYDEV_CHIP_REVISION_4F_PRODUCTION_256DMA EQU 0
CYDEV_CHIP_REVISION_4F_PRODUCTION_256K EQU 0
CYDEV_CHIP_REVISION_4G_ES EQU 17
CYDEV_CHIP_REVISION_4G_ES2 EQU 33
CYDEV_CHIP_REVISION_4G_PRODUCTION EQU 17
CYDEV_CHIP_REVISION_4H_PRODUCTION EQU 0
CYDEV_CHIP_REVISION_4I_PRODUCTION EQU 0
CYDEV_CHIP_REVISION_4J_PRODUCTION EQU 0
CYDEV_CHIP_REVISION_4K_PRODUCTION EQU 0
CYDEV_CHIP_REVISION_4L_PRODUCTION EQU 0
CYDEV_CHIP_REVISION_4M_PRODUCTION EQU 0
CYDEV_CHIP_REVISION_4N_PRODUCTION EQU 0
CYDEV_CHIP_REVISION_4O_PRODUCTION EQU 0
CYDEV_CHIP_REVISION_4P_PRODUCTION EQU 0
CYDEV_CHIP_REVISION_4Q_PRODUCTION EQU 0
CYDEV_CHIP_REVISION_4R_PRODUCTION EQU 0
CYDEV_CHIP_REVISION_4S_PRODUCTION EQU 0
CYDEV_CHIP_REVISION_4T_PRODUCTION EQU 0
CYDEV_CHIP_REVISION_4U_PRODUCTION EQU 0
CYDEV_CHIP_REVISION_4V_PRODUCTION EQU 0
CYDEV_CHIP_REVISION_4W_PRODUCTION EQU 0
CYDEV_CHIP_REVISION_4X_PRODUCTION EQU 0
CYDEV_CHIP_REVISION_4Y_PRODUCTION EQU 0
CYDEV_CHIP_REVISION_4Z_PRODUCTION EQU 0
CYDEV_CHIP_REVISION_5A_ES0 EQU 0
CYDEV_CHIP_REVISION_5A_ES1 EQU 1
CYDEV_CHIP_REVISION_5A_PRODUCTION EQU 1
CYDEV_CHIP_REVISION_5B_ES0 EQU 0
CYDEV_CHIP_REVISION_5B_PRODUCTION EQU 0
CYDEV_CHIP_REVISION_6A_ES EQU 17
CYDEV_CHIP_REVISION_6A_NO_UDB EQU 33
CYDEV_CHIP_REVISION_6A_PRODUCTION EQU 33
CYDEV_CHIP_REVISION_FM3_PRODUCTION EQU 0
CYDEV_CHIP_REVISION_FM4_PRODUCTION EQU 0
CYDEV_CHIP_REVISION_PDL_FM0P_TYPE1_PRODUCTION EQU 0
CYDEV_CHIP_REVISION_PDL_FM0P_TYPE2_PRODUCTION EQU 0
CYDEV_CHIP_REVISION_PDL_FM0P_TYPE3_PRODUCTION EQU 0
CYDEV_CHIP_REVISION_USED EQU CYDEV_CHIP_REVISION_5B_PRODUCTION
CYDEV_CHIP_REV_EXPECT EQU CYDEV_CHIP_REVISION_USED
CYDEV_CONFIG_FASTBOOT_ENABLED EQU 1
CYDEV_CONFIG_UNUSED_IO_AllowButWarn EQU 0
CYDEV_CONFIG_UNUSED_IO EQU CYDEV_CONFIG_UNUSED_IO_AllowButWarn
CYDEV_CONFIG_UNUSED_IO_AllowWithInfo EQU 1
CYDEV_CONFIG_UNUSED_IO_Disallowed EQU 2
CYDEV_CONFIGURATION_COMPRESSED EQU 1
CYDEV_CONFIGURATION_DMA EQU 0
CYDEV_CONFIGURATION_ECC EQU 1
CYDEV_CONFIGURATION_IMOENABLED EQU CYDEV_CONFIG_FASTBOOT_ENABLED
CYDEV_CONFIGURATION_MODE_COMPRESSED EQU 0
CYDEV_CONFIGURATION_MODE EQU CYDEV_CONFIGURATION_MODE_COMPRESSED
CYDEV_CONFIGURATION_MODE_DMA EQU 2
CYDEV_CONFIGURATION_MODE_UNCOMPRESSED EQU 1
CYDEV_DEBUG_ENABLE_MASK EQU 0x20
CYDEV_DEBUG_ENABLE_REGISTER EQU CYREG_MLOGIC_DEBUG
CYDEV_DEBUGGING_DPS_Disable EQU 3
CYDEV_DEBUGGING_DPS_JTAG_4 EQU 1
CYDEV_DEBUGGING_DPS_JTAG_5 EQU 0
CYDEV_DEBUGGING_DPS_SWD EQU 2
CYDEV_DEBUGGING_DPS_SWD_SWV EQU 6
CYDEV_DEBUGGING_DPS EQU CYDEV_DEBUGGING_DPS_SWD_SWV
CYDEV_DEBUGGING_ENABLE EQU 1
CYDEV_DEBUGGING_XRES EQU 0
CYDEV_DMA_CHANNELS_AVAILABLE EQU 24
CYDEV_ECC_ENABLE EQU 0
CYDEV_HEAP_SIZE EQU 0x80
CYDEV_INSTRUCT_CACHE_ENABLED EQU 1
CYDEV_INTR_RISING EQU 0x00000000
CYDEV_IS_EXPORTING_CODE EQU 0
CYDEV_IS_IMPORTING_CODE EQU 0
CYDEV_PROJ_TYPE EQU 0
CYDEV_PROJ_TYPE_BOOTLOADER EQU 1
CYDEV_PROJ_TYPE_LAUNCHER EQU 5
CYDEV_PROJ_TYPE_LOADABLE EQU 2
CYDEV_PROJ_TYPE_LOADABLEANDBOOTLOADER EQU 4
CYDEV_PROJ_TYPE_MULTIAPPBOOTLOADER EQU 3
CYDEV_PROJ_TYPE_STANDARD EQU 0
CYDEV_PROTECTION_ENABLE EQU 0
CYDEV_STACK_SIZE EQU 0x0800
CYDEV_USE_BUNDLED_CMSIS EQU 1
CYDEV_VARIABLE_VDDA EQU 0
CYDEV_VDDA_MV EQU 5000
CYDEV_VDDD_MV EQU 5000
CYDEV_VDDIO0_MV EQU 5000
CYDEV_VDDIO1_MV EQU 5000
CYDEV_VDDIO2_MV EQU 5000
CYDEV_VDDIO3_MV EQU 5000
CYDEV_VIO0_MV EQU 5000
CYDEV_VIO1_MV EQU 5000
CYDEV_VIO2_MV EQU 5000
CYDEV_VIO3_MV EQU 5000
CYIPBLOCK_ARM_CM3_VERSION EQU 0
CYIPBLOCK_P3_ANAIF_VERSION EQU 0
CYIPBLOCK_P3_CAN_VERSION EQU 0
CYIPBLOCK_P3_CAPSENSE_VERSION EQU 0
CYIPBLOCK_P3_COMP_VERSION EQU 0
CYIPBLOCK_P3_DECIMATOR_VERSION EQU 0
CYIPBLOCK_P3_DFB_VERSION EQU 0
CYIPBLOCK_P3_DMA_VERSION EQU 0
CYIPBLOCK_P3_DRQ_VERSION EQU 0
CYIPBLOCK_P3_DSM_VERSION EQU 0
CYIPBLOCK_P3_EMIF_VERSION EQU 0
CYIPBLOCK_P3_I2C_VERSION EQU 0
CYIPBLOCK_P3_LCD_VERSION EQU 0
CYIPBLOCK_P3_LPF_VERSION EQU 0
CYIPBLOCK_P3_OPAMP_VERSION EQU 0
CYIPBLOCK_P3_PM_VERSION EQU 0
CYIPBLOCK_P3_SCCT_VERSION EQU 0
CYIPBLOCK_P3_TIMER_VERSION EQU 0
CYIPBLOCK_P3_USB_VERSION EQU 0
CYIPBLOCK_P3_VIDAC_VERSION EQU 0
CYIPBLOCK_P3_VREF_VERSION EQU 0
CYIPBLOCK_S8_GPIO_VERSION EQU 0
CYIPBLOCK_S8_IRQ_VERSION EQU 0
CYIPBLOCK_S8_SAR_VERSION EQU 0
CYIPBLOCK_S8_SIO_VERSION EQU 0
CYIPBLOCK_S8_UDB_VERSION EQU 0
DMA_CHANNELS_USED__MASK0 EQU 0x00000000
CYDEV_BOOTLOADER_ENABLE EQU 0
    ENDIF
    END
